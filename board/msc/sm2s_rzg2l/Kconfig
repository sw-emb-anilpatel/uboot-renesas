## board/msc/sm2s_rzg2l/Kconfig
```kconfig
if TARGET_SM2S_RZG2L

source "board/msc/common/Kconfig"

config SYS_SOC
	default "rmobile"

config SYS_BOARD
	default "sm2s_rzg2l"

config SYS_VENDOR
	default "msc"

config SYS_CONFIG_NAME
	default "msc-sm2s-rzg2l"

endif
```

## board/msc/sm2s_rzg2ul/Kconfig
```kconfig
if TARGET_SM2S_RZG2UL

source "board/msc/common/Kconfig"

config SYS_SOC
	default "rmobile"

config SYS_BOARD
	default "sm2s_rzg2ul"

config SYS_VENDOR
	default "msc"

config SYS_CONFIG_NAME
	default "msc-sm2s-rzg2ul"

endif
```

## board/msc/sm2s_rzv2l/Kconfig
```kconfig
source "board/msc/common/Kconfig"

config SYS_SOC
	default "rmobile"

config SYS_BOARD
	default "sm2s_rzv2l"

config SYS_VENDOR
	default "msc"

config SYS_CONFIG_NAME
	default "msc-sm2s-rzv2l"
```
